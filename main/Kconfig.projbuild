## main/Kconfig.projbuild
```kconfig
menu "FT8/FT4 Receiver"

    config FTX_NTP_SERVER
        string "NTP server"
        default "ntp1.neu.edu.cn"

    config FTX_CALLSIGN
        string "Receiver callsign"
        default ""

    config FTX_GRID
        string "Receiver Maidenhead grid"
        default ""

    config FTX_DIAL_FREQUENCY_HZ
        int "Receiver dial frequency in Hz"
        default 14074000

    config FTX_PSK_REPORTER_ENABLE
        bool "Enable PSK Reporter upload"
        default n

endmenu
```

## sdkconfig.defaults
```kconfig
CONFIG_SPIRAM=y
CONFIG_BSP_LCD_RGB_BUFFER_NUMS=1
CONFIG_BSP_LCD_DRAW_BUF_HEIGHT=20
# CONFIG_BSP_LCD_DRAW_BUF_DOUBLE is not set
CONFIG_PARTITION_TABLE_CUSTOM=y
CONFIG_PARTITION_TABLE_CUSTOM_FILENAME="partitions.csv"
```
